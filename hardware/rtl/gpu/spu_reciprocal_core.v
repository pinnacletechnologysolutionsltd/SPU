// spu_reciprocal_core.v — multiply-only fixed-point reciprocal: normalize
// (leading-one detector + barrel shift) -> 256-entry LUT -> 1
// Newton-Raphson iteration. Denormalization is implicit in exp_out: the
// caller reads 1/d ~= y_out / 2**exp_out.
//
// Characterized exhaustively against the mantissa domain in
// software/lib/gpu_reciprocal_oracle.py. The 34-bit d_in width and
// degenerate-input handling were added by pre-implementation
// halt-and-flag review (the original sketch used a 25-bit d_in, sized
// to typical 640x480 geometry, not the full range c0+c1+c2 can
// produce). See spu_strategy/contract_gpu_depth_v2_shared_multiplier_arch_2026-08-25.md.
//
// Does NOT own a multiplier instance: mult_a/mult_b/mult_p are a
// request/result port to a shared spu_shared_mult35 instance, driven
// combinationally by this core's current state -- select, not
// arbitration, since this core and its caller never contend (the
// contract's §8 terminology correction).
//
// No floating point, no division: normalize/shift/ROM-lookup/multiply
// only. CC0 1.0 Universal.

module spu_reciprocal_core (
    input  wire        clk,
    input  wire        rst_n,
    input  wire        start,
    input  wire [33:0] d_in,          // |denominator|, up to 34 bits
    output reg  [15:0] y_out,         // 1/d ~= y_out / 2**exp_out
    output reg  [6:0]  exp_out,
    output reg         done,
    output reg         degenerate,    // d_in==0 at start: y_out forced 0
    output wire [39:0] mult_a,
    output wire [16:0] mult_b,
    input  wire [56:0] mult_p,
    output wire        busy
);

    localparam MANT_BITS = 16;
    localparam OUT_FRAC   = 15;
    localparam [32:0] TWO_FX = 33'h1_0000_0000;  // 2**32, the NR constant "2"

    localparam [2:0] S_IDLE = 3'd0, S_LUT = 3'd1, S_NR0 = 3'd2,
                      S_SUB = 3'd3, S_NR1 = 3'd4, S_DONE = 3'd5;
    reg [2:0] state;

    assign busy = (state != S_IDLE);

    // ROM, generated by tools/generate_gpu_reciprocal_lut.py -- never
    // hand-edit, regenerate via that script (AGENTS.md §3.4).
    reg [15:0] rom [0:255];
    initial $readmemh("hardware/rtl/arch/gpu_reciprocal_lut_q15.mem", rom);

    // Leading-one position, 0 if d_in==0 (that case is special-cased in
    // the FSM below and never reaches this combinationally-undefined
    // input).
    function [5:0] find_msb;
        input [33:0] val;
        integer i;
        reg found;
        begin
            find_msb = 6'd0;
            found = 1'b0;
            for (i = 33; i >= 0; i = i - 1) begin
                if (!found && val[i]) begin
                    find_msb = i[5:0];
                    found = 1'b1;
                end
            end
        end
    endfunction

    wire [5:0] msb_pos = find_msb(d_in);
    wire signed [7:0] shift_amt = {2'b00, msb_pos} - 8'sd15;
    wire [33:0] shifted_right = d_in >> shift_amt;
    wire [33:0] shifted_left  = d_in << (-shift_amt);
    wire [33:0] mant_full = shift_amt[7] ? shifted_left : shifted_right;
    wire [15:0] mantissa_c = mant_full[15:0];
    wire signed [7:0] exp_signed = 8'sd31 + shift_amt;
    wire [6:0] exp_c = exp_signed[6:0];

    reg [15:0] mantissa_reg;
    reg [6:0]  exp_reg;
    reg [15:0] y0_reg;
    reg [32:0] prod_reg;
    reg [32:0] err_reg;
    reg [48:0] y1full_reg;

    // mult_a/mult_b: combinational functions of state, valid throughout
    // the cycle their issuing state is active (matches pade_eval_4_4.v's
    // multiply-issue timing: the multiply's inputs are stable for a full
    // cycle, and the result is captured on that same cycle's edge).
    assign mult_a = (state == S_NR0) ? {24'd0, mantissa_reg} :
                     (state == S_NR1) ? {7'd0, err_reg} : 40'd0;
    assign mult_b = (state == S_NR0 || state == S_NR1) ? {1'd0, y0_reg} : 17'd0;

    always @(posedge clk or negedge rst_n) begin
        if (!rst_n) begin
            state <= S_IDLE;
            done <= 1'b0;
            degenerate <= 1'b0;
            y_out <= 16'd0;
            exp_out <= 7'd0;
        end else begin
            done <= 1'b0;
            case (state)
                S_IDLE: begin
                    if (start) begin
                        if (d_in == 34'd0) begin
                            y_out <= 16'd0;
                            exp_out <= 7'd0;
                            degenerate <= 1'b1;
                            done <= 1'b1;
                        end else begin
                            mantissa_reg <= mantissa_c;
                            exp_reg <= exp_c;
                            degenerate <= 1'b0;
                            state <= S_LUT;
                        end
                    end
                end
                S_LUT: begin
                    y0_reg <= rom[mantissa_reg[14:7]];
                    state <= S_NR0;
                end
                S_NR0: begin
                    prod_reg <= mult_p[32:0];
                    state <= S_SUB;
                end
                S_SUB: begin
                    err_reg <= TWO_FX - prod_reg;
                    state <= S_NR1;
                end
                S_NR1: begin
                    y1full_reg <= mult_p[48:0];
                    state <= S_DONE;
                end
                S_DONE: begin
                    y_out <= y1full_reg[46:31];
                    exp_out <= exp_reg;
                    done <= 1'b1;
                    state <= S_IDLE;
                end
                default: state <= S_IDLE;
            endcase
        end
    end

endmodule
