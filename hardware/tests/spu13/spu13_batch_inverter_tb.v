`timescale 1ns / 1ps

// spu13_batch_inverter_tb.v — Montgomery batch inversion testbench
//
// Loads golden vectors from build/batch_inv_golden.mem (generated by
// test_pade_batch_inversion.py --emit-mem), feeds them to the DUT,
// and checks outputs against expected values mechanically.

module spu13_batch_inverter_tb;

    reg         clk;
    reg         rst_n;

    reg         start;
    reg  [3:0]  batch_size;
    reg  [31:0] d0, d1, d2, d3;
    reg         d_valid;
    reg         d_last;

    wire [31:0] inv0, inv1, inv2, inv3;
    wire        inv_valid;
    wire        inv_singular;
    wire        done;
    wire        busy;
    wire [3:0]  debug_state;

    spu13_batch_inverter #(.MAX_BATCH(8)) u_dut (
        .clk(clk), .rst_n(rst_n),
        .start(start), .batch_size(batch_size),
        .d0(d0), .d1(d1), .d2(d2), .d3(d3),
        .d_valid(d_valid), .d_last(d_last),
        .inv0(inv0), .inv1(inv1), .inv2(inv2), .inv3(inv3),
        .inv_valid(inv_valid), .inv_singular(inv_singular),
        .done(done), .busy(busy),
        .debug_state(debug_state)
    );

    // ── Golden vector storage (flat $readmemh) ──────────────────────
    reg [31:0] golden [0:127];
    integer    gptr;
    integer    n_cases;
    integer    case_idx;
    integer    k_golden;
    integer    lane_idx;

    // Expected values for current case (stored during feed)
    reg [31:0] exp_inv0 [0:7];
    reg [31:0] exp_inv1 [0:7];
    reg [31:0] exp_inv2 [0:7];
    reg [31:0] exp_inv3 [0:7];
    reg        exp_sing [0:7];

    // Captured DUT outputs
    reg [31:0] cap_inv0 [0:7];
    reg [31:0] cap_inv1 [0:7];
    reg [31:0] cap_inv2 [0:7];
    reg [31:0] cap_inv3 [0:7];
    reg        cap_sing [0:7];
    reg [3:0]  cap_cnt;

    integer    errors;
    integer    total_lanes;

    always #5 clk = ~clk;

    // ── Capture DUT outputs ─────────────────────────────────────────
    always @(posedge clk) begin
        if (inv_valid) begin
            cap_inv0[cap_cnt] <= inv0;
            cap_inv1[cap_cnt] <= inv1;
            cap_inv2[cap_cnt] <= inv2;
            cap_inv3[cap_cnt] <= inv3;
            cap_sing[cap_cnt] <= inv_singular;
            cap_cnt <= cap_cnt + 1;
        end
    end

    // ── Main test sequence ──────────────────────────────────────────
    initial begin
        clk = 0; rst_n = 0; start = 0;
        d_valid = 0; d_last = 0;
        d0 = 0; d1 = 0; d2 = 0; d3 = 0;
        errors = 0;
        total_lanes = 0;

        $readmemh("build/batch_inv_golden.mem", golden);
        n_cases = golden[0];
        gptr = 1;

        $display("=== SPU-13 Batch Inverter — Golden Vector Test ===");
        $display("  Golden file: build/batch_inv_golden.mem");
        $display("  Test cases:  %0d", n_cases);

        #20 rst_n = 1;
        #20;

        for (case_idx = 0; case_idx < n_cases; case_idx = case_idx + 1) begin
            k_golden = golden[gptr];
            gptr = gptr + 1;
            $display("--- Case %0d: k=%0d ---", case_idx, k_golden);
            cap_cnt = 0;

            // Feed denominators and capture expected values
            batch_size = k_golden[3:0];
            start = 1; #10 start = 0;

            for (lane_idx = 0; lane_idx < k_golden; lane_idx = lane_idx + 1) begin
                // Read and store expected values
                exp_inv0[lane_idx] = golden[gptr + 4];
                exp_inv1[lane_idx] = golden[gptr + 5];
                exp_inv2[lane_idx] = golden[gptr + 6];
                exp_inv3[lane_idx] = golden[gptr + 7];
                exp_sing[lane_idx]  = golden[gptr + 8];

                // Feed denominator to DUT
                d0 = golden[gptr + 0];
                d1 = golden[gptr + 1];
                d2 = golden[gptr + 2];
                d3 = golden[gptr + 3];
                gptr = gptr + 9;

                d_valid = 1;
                d_last  = (lane_idx == k_golden - 1);
                #10;
                d_valid = 0; d_last = 0;
            end

            // Wait for DUT to complete
            wait(done);
            repeat (3) @(posedge clk);

            // Verify
            for (lane_idx = 0; lane_idx < k_golden; lane_idx = lane_idx + 1) begin
                if (exp_sing[lane_idx]) begin
                    if (!cap_sing[lane_idx]) begin
                        $display("  FAIL: lane %0d expected singular, got unit", lane_idx);
                        errors = errors + 1;
                    end else
                        $display("  ok  lane %0d singular", lane_idx);
                end else begin
                    if (cap_sing[lane_idx]) begin
                        $display("  FAIL: lane %0d expected unit, got singular", lane_idx);
                        errors = errors + 1;
                    end else if (cap_inv0[lane_idx] != exp_inv0[lane_idx] ||
                                 cap_inv1[lane_idx] != exp_inv1[lane_idx] ||
                                 cap_inv2[lane_idx] != exp_inv2[lane_idx] ||
                                 cap_inv3[lane_idx] != exp_inv3[lane_idx]) begin
                        $display("  FAIL: lane %0d inv mismatch", lane_idx);
                        $display("    got:      (%h,%h,%h,%h)",
                                 cap_inv0[lane_idx], cap_inv1[lane_idx],
                                 cap_inv2[lane_idx], cap_inv3[lane_idx]);
                        $display("    expected: (%h,%h,%h,%h)",
                                 exp_inv0[lane_idx], exp_inv1[lane_idx],
                                 exp_inv2[lane_idx], exp_inv3[lane_idx]);
                        errors = errors + 1;
                    end else
                        $display("  ok  lane %0d inv matches golden", lane_idx);
                end
                total_lanes = total_lanes + 1;
            end
        end

        $display("============================================");
        if (errors == 0)
            $display("PASS: %0d lanes verified against golden vectors", total_lanes);
        else
            $display("FAIL: %0d errors in %0d lanes", errors, total_lanes);
        $finish;
    end

endmodule
